/* Copyright (c) 2014, The Linux Foundation. All rights reserved.
 *
 * This program is free software; you can redistribute it and/or modify
 * it under the terms of the GNU General Public License version 2 and
 * only version 2 as published by the Free Software Foundation.
 *
 * This program is distributed in the hope that it will be useful,
 * but WITHOUT ANY WARRANTY; without even the implied warranty of
 * MERCHANTABILITY or FITNESS FOR A PARTICULAR PURPOSE.  See the
 * GNU General Public License for more details.
 */

&mdss_mdp {
	dsi_samsung_s6e3fc1_cmd: qcom,mdss_dsi_samsung_s6e3fc1_cmd {
		qcom,cont-splash-enabled;
		qcom,panel-supply-entries = <&dsi_panel_pwr_supply_no_labibb>;
		qcom,mdss-dsi-panel-name = "samsung s6e3fc1 cmd mode dsi panel";
		qcom,mdss-dsi-panel-controller = <&mdss_dsi0>;
		qcom,mdss-dsi-panel-type = "dsi_cmd_mode";
		qcom,mdss-dsi-panel-destination = "display_1";
		qcom,mdss-dsi-panel-width = <1080>;
		qcom,mdss-dsi-panel-height = <2160>;
		qcom,mdss-dsi-h-front-porch = <128>;
		qcom,mdss-dsi-h-back-porch = <64>;
		qcom,mdss-dsi-h-pulse-width = <16>;
		qcom,mdss-dsi-v-back-porch = <4>;
		qcom,mdss-dsi-v-front-porch = <18>;
		qcom,mdss-dsi-v-pulse-width = <2>;
		qcom,mdss-dsi-bpp = <24>;
		qcom,mdss-dsi-on-command = [
			05 01 00 00 14 00 02 11 00
			15 01 00 00 00 00 02 35 00
			39 01 00 00 00 00 03 FC 5A 5A
			39 01 00 00 00 00 04 E8 64 08 0C
			39 01 00 00 00 00 03 FC A5 A5
			39 01 00 00 00 00 03 F0 5A 5A
			39 01 00 00 00 00 02 B0 01
			39 01 00 00 00 00 02 ED 04
			39 01 00 00 00 00 03 F0 A5 A5
			15 01 00 00 00 00 02 53 20
			15 01 00 00 00 00 02 55 00
			05 01 00 00 00 00 02 29 00];
		qcom,mdss-dsi-off-command = [
			05 01 00 00 0A 00 02 28 00
			05 01 00 00 A0 00 02 10 00];
		qcom,mdss-dsi-off-command-state = "dsi_hs_mode";
		qcom,mdss-dsi-h-sync-pulse = <1>;
		qcom,mdss-dsi-bllp-eof-power-mode;
		qcom,mdss-dsi-bllp-power-mode;
		qcom,mdss-dsi-lane-0-state;
		qcom,mdss-dsi-lane-1-state;
		qcom,mdss-dsi-lane-2-state;
		qcom,mdss-dsi-lane-3-state;
		qcom,mdss-dsi-panel-timings = [00 20 07 07 0c 12 06 08 06 03 04 00];
		qcom,esd-check-enabled;
		qcom,mdss-dsi-panel-status-check-mode = "te_signal_check";
		qcom,mdss-dsi-te-check-enable;
		qcom,mdss-dsi-te-using-te-pin;
		qcom,mdss-dsi-t-clk-post = <0x08>;
		qcom,mdss-dsi-t-clk-pre = <0x30>;
		qcom,mdss-dsi-bl-min-level = <1>;
		qcom,mdss-dsi-bl-max-level = <1023>;
		qcom,mdss-brightness-max-level = <1023>;
		qcom,mdss-bl-high2bit;
		qcom,mdss-dsi-bl-pmic-control-type = "bl_ctrl_dcs";
		qcom,mdss-dsi-reset-sequence = <1 2>, <0 2>, <1 2>;
		qcom,mdss-pan-physical-width-dimension = <68>;
		qcom,mdss-pan-physical-height-dimension = <137>;
		qcom,ulps-enabled;
		qcom,panel-allow-phy-poweroff;
	};
};
