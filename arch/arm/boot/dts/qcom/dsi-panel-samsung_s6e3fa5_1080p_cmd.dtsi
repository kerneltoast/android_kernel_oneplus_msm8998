/* Copyright (c) 2014, The Linux Foundation. All rights reserved.
 *
 * This program is free software; you can redistribute it and/or modify
 * it under the terms of the GNU General Public License version 2 and
 * only version 2 as published by the Free Software Foundation.
 *
 * This program is distributed in the hope that it will be useful,
 * but WITHOUT ANY WARRANTY; without even the implied warranty of
 * MERCHANTABILITY or FITNESS FOR A PARTICULAR PURPOSE.  See the
 * GNU General Public License for more details.
 */

&mdss_mdp {
	dsi_samsung_s6e3fa5_1080p_cmd: qcom,mdss_dsi_samsung_s6e3fa5_1080p_cmd {
		qcom,cont-splash-enabled;
		qcom,panel-supply-entries = <&dsi_panel_pwr_supply_no_labibb>;
		qcom,mdss-dsi-panel-name = "samsung s6e3fa5 1080p cmd mode dsi panel";
		qcom,mdss-dsi-panel-controller = <&mdss_dsi0>;
		qcom,mdss-dsi-panel-type = "dsi_cmd_mode";
		qcom,mdss-dsi-panel-destination = "display_1";
		qcom,mdss-dsi-panel-width = <1080>;
		qcom,mdss-dsi-panel-height = <1920>;
		qcom,mdss-dsi-panel-orientation = "180";
		qcom,mdss-dsi-h-front-porch = <120>;
		qcom,mdss-dsi-h-back-porch = <70>;
		qcom,mdss-dsi-h-pulse-width = <19>;
		qcom,mdss-dsi-v-back-porch = <4>;
		qcom,mdss-dsi-v-front-porch = <18>;
		qcom,mdss-dsi-v-pulse-width = <2>;
		qcom,mdss-dsi-bpp = <24>;
		qcom,mdss-dsi-on-command = [
			05 01 00 00 14 00 02 11 00
			15 01 00 00 00 00 02 35 00
			39 01 00 00 00 00 03 F0 5A 5A
			39 01 00 00 00 00 02 B0 04
			39 01 00 00 00 00 04 B4 06 0C 12
			39 01 00 00 00 00 03 F0 A5 A5
			15 01 00 00 00 00 02 53 20
			15 01 00 00 00 00 02 55 00
			39 01 00 00 00 00 03 F0 5A 5A
			39 01 00 00 00 00 02 C3 01
			39 01 00 00 00 00 02 B0 18
			39 01 00 00 00 00 02 C3 00
			39 01 00 00 00 00 03 F0 A5 A5
			05 01 00 00 00 00 02 29 00];
		qcom,mdss-dsi-off-command = [
			05 01 00 00 28 00 02 28 00
			05 01 00 00 A0 00 02 10 00];
		qcom,mdss-dsi-off-command-state = "dsi_hs_mode";
		qcom,mdss-dsi-h-sync-pulse = <1>;
		qcom,mdss-dsi-bllp-eof-power-mode;
		qcom,mdss-dsi-bllp-power-mode;
		qcom,mdss-dsi-lane-0-state;
		qcom,mdss-dsi-lane-1-state;
		qcom,mdss-dsi-lane-2-state;
		qcom,mdss-dsi-lane-3-state;
		qcom,mdss-dsi-panel-timings = [00 1b 06 06 0b 10 06 07 05 03 04 00];
		qcom,esd-check-enabled;
		qcom,mdss-dsi-panel-status-check-mode = "te_signal_check";
		qcom,mdss-dsi-te-check-enable;
		qcom,mdss-dsi-te-using-te-pin;
		qcom,mdss-dsi-t-clk-post = <0x07>;
		qcom,mdss-dsi-t-clk-pre = <0x29>;
		qcom,mdss-dsi-bl-min-level = <1>;
		qcom,mdss-dsi-bl-pmic-control-type = "bl_ctrl_dcs";
		qcom,mdss-dsi-reset-sequence = <1 2>, <0 2>, <1 2>;
		qcom,mdss-pan-physical-width-dimension = <68>;
		qcom,mdss-pan-physical-height-dimension = <122>;
		qcom,ulps-enabled;
		qcom,panel-allow-phy-poweroff;
	};
};
